## meta-optologic-tdx-common/conf/layer.conf
```bitbake
# We have a conf and classes directory, add to BBPATH
BBPATH .= ":${LAYERDIR}"

BBFILE_COLLECTIONS += "meta-optologic-tdx-common"
BBFILE_PATTERN_meta-optologic-tdx-common = "^${LAYERDIR}/"
# This layer has higher priority than the meta-toradex-* layers
BBFILE_PRIORITY_meta-optologic-tdx-common = "25"

LAYERDEPENDS_meta-optologic-tdx-common = "core toradex-bsp-common-layer"
LAYERSERIES_COMPAT_meta-optologic-tdx-common = "scarthgap"

# Toradex kernel recipes rely on using a Toradex defined MACHINE instead of a custom one.
# To extend a MACHINE configuration, a conf file has to be loaded in layer.conf
# https://developer.toradex.com/linux-bsp/os-development/build-yocto/custom-meta-layers-recipes-and-images-in-yocto-project-hello-world-examples#add-a-custom-kernel-configuration
require conf/machine/include/optologic-extra.inc
```

## meta-optologic-tdx-common/conf/machine/include/optologic-extra.inc
```bitbake
#@TYPE: Machine Include
#@NAME: Optologic Display support for Toradex boards
#@DESCRIPTION: Common support for Optologic Displays on Toradex starter kit.
#@MAINTAINER: OPTO Logic TECHNOLOGY S.A. <support@optologic.ch>

# Build the Optologic Display overlays for Toradex SoMs
MACHINE_ESSENTIAL_EXTRA_RDEPENDS:append:ti-soc = " device-tree-overlays-optologic-ti"
MACHINE_ESSENTIAL_EXTRA_RDEPENDS:append:imx-generic-bsp = " device-tree-overlays-optologic-nxp"

# List of Optologic overlays to compile and include in the image.
# Relies on using a MACHINE as defined by Toradex, like the other Toradex
# kernel recipes rely on. This assignment doesn't support custom MACHINE names.
# https://developer.toradex.com/linux-bsp/os-development/build-yocto/custom-meta-layers-recipes-and-images-in-yocto-project-hello-world-examples#add-a-custom-kernel-configuration
OPTOLOGIC_DEVICETREE_OVERLAYS ?= " \
    ${MACHINE}_optologic_panel-cap-touch-5inch-SCX0500132GGC06-lvds_overlay.dtbo \
    ${MACHINE}_optologic_panel-cap-touch-7inch-SCX0700117GGC03-lvds_overlay.dtbo \
    ${MACHINE}_optologic_panel-cap-touch-10inch-SCX1001511GGC49-lvds_overlay.dtbo \
    "

# Choose the OPTO logic Display to load at boot time by assigning this variable.
OPTOLOGIC_DEVICETREE_OVERLAYS_BOOT ?= "${MACHINE}_optologic_panel-cap-touch-5inch-SCX0500132GGC06-lvds_overlay.dtbo"
```

## meta-optologic-tdx-nxp/conf/layer.conf
```bitbake
# We have a conf and classes directory, add to BBPATH
BBPATH .= ":${LAYERDIR}"

# We have recipes-* directories, add to BBFILES
BBFILES += "${LAYERDIR}/recipes-*/*/*.bb \
            ${LAYERDIR}/recipes-*/*/*.bbappend"

BBFILE_COLLECTIONS += "meta-optologic-tdx-nxp"
BBFILE_PATTERN_meta-optologic-tdx-nxp = "^${LAYERDIR}/"
# This layer has higher priority than the meta-toradex-* layers
BBFILE_PRIORITY_meta-optologic-tdx-nxp = "26"

LAYERDEPENDS_meta-optologic-tdx-nxp = "core toradex-nxp-layer meta-optologic-tdx-common"
LAYERSERIES_COMPAT_meta-optologic-tdx-nxp = "scarthgap"
```

## meta-optologic-tdx-ti/conf/layer.conf
```bitbake
# We have a conf and classes directory, add to BBPATH
BBPATH .= ":${LAYERDIR}"

# We have recipes-* directories, add to BBFILES
BBFILES += "${LAYERDIR}/recipes-*/*/*.bb \
            ${LAYERDIR}/recipes-*/*/*.bbappend"

BBFILE_COLLECTIONS += "meta-optologic-tdx-ti"
BBFILE_PATTERN_meta-optologic-tdx-ti = "^${LAYERDIR}/"
# This layer has higher priority than the meta-toradex-* layers
BBFILE_PRIORITY_meta-optologic-tdx-ti = "26"

LAYERDEPENDS_meta-optologic-tdx-ti = "core toradex-ti-layer meta-optologic-tdx-common"
LAYERSERIES_COMPAT_meta-optologic-tdx-ti = "scarthgap"
```

## meta-optologic-tdx-ti/conf/machine/include/optologic-extra-ti.inc
```bitbake
#@TYPE: Machine Include
#@NAME: Optologic Display support for Toradex boards
#@DESCRIPTION: Adds support for Optologic Displays on Toradex starter kit with the TI SoMs.
#@MAINTAINER: OPTO Logic TECHNOLOGY S.A. <support@optologic.ch>

# Build the Optologic Display overlays for Toradex TI SoMs
MACHINE_ESSENTIAL_EXTRA_RDEPENDS += "device-tree-overlays-optologic-ti"
```

## meta-optologic-tdx/conf/layer.conf
```bitbake
# We have a conf and classes directory, add to BBPATH
BBPATH .= ":${LAYERDIR}"

# We have recipes-* directories, add to BBFILES
BBFILES += "${LAYERDIR}/recipes-*/*/*.bb \
            ${LAYERDIR}/recipes-*/*/*.bbappend"

BBFILE_COLLECTIONS += "meta-optologic-tdx"
BBFILE_PATTERN_meta-optologic-tdx = "^${LAYERDIR}/"
# This layer has higher priority than the meta-toradex-* layers
BBFILE_PRIORITY_meta-optologic-tdx = "25"

LAYERDEPENDS_meta-optologic-tdx = "core toradex-bsp-common-layer"
# Depending on your SOC, also use the meta-toradex-ti or meta-toradex-nxp layers
LAYERSERIES_COMPAT_meta-optologic-tdx = "scarthgap"
```

## meta-optologic-tdx/conf/machine/include/optologic-extra.inc
```bitbake
#@TYPE: Machine Include
#@NAME: Optologic Display support for Toradex boards
#@DESCRIPTION: Adds support for Optologic Displays on Toradex starter kit with the Verdin and Colibri SoMs.
#@MAINTAINER: OPTO Logic TECHNOLOGY S.A. <support@optologic.ch>

# Build the Optologic Display overlays for Toradex SoMs
MACHINE_ESSENTIAL_EXTRA_RDEPENDS += "device-tree-overlays-optologic"

# List of Optologic overlays to compile and include in the image.
# Relies on using a MACHINE as defined by Toradex, like the other Toradex
# kernel recipes rely on. This assignment doesn't support custom MACHINE names.
# https://developer.toradex.com/linux-bsp/os-development/build-yocto/custom-meta-layers-recipes-and-images-in-yocto-project-hello-world-examples#add-a-custom-kernel-configuration
OPTOLOGIC_DEVICETREE_OVERLAYS ?= " \
    ${MACHINE}_optologic_panel-cap-touch-7inch-lvds_overlay.dtbo \
    "

# Choose the OPTO logic Display to load at boot time by assigning this variable.
OPTOLOGIC_DEVICETREE_OVERLAYS_BOOT ?= "${MACHINE}_optologic_panel-cap-touch-7inch-lvds_overlay.dtbo"
```
